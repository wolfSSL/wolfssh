## zephyr/Kconfig
```kconfig
menuconfig WOLFSSH
	bool "wolfSSH module support"
	select WOLFSSL

if WOLFSSH
config WOLFSSH_SETTINGS_FILE
	string "wolfSSH settings file"
	help
	  Use a specific wolfSSH settings file.

config WOLFSSH_SFTP_DEFAULT_DIR
	string "wolfSSH sftp default directory"
	help
	  Use a specific directory as the default wolfSSH sftp working directory.

config WOLFSSH_DEBUG
	bool "wolfSSH debug activation"
	help
	  Enable debugging activation for wolfSSH.

config ZEPHYR_WOLFSSH_MODULE
	bool
	depends on WOLFSSH
endif
```

## zephyr/samples/tests/sample.yaml
```yaml
sample:
  description: wolfSSH tests
  name: wolfSSH tests
common:
  harness: console
  harness_config:
    type: one_line
    regex:
      - "Zephyr wolfSSH tests passed"
tests:
  sample.lib.wolfssh_tests:
    timeout: 200
    platform_allow: qemu_x86
    integration_platforms:
      - qemu_x86
  sample.lib.wolfssh_nofs_tests:
    timeout: 200
    platform_allow: qemu_x86
    extra_args: CONF_FILE="prj_nofs.conf"
    integration_platforms:
      - qemu_x86
```
